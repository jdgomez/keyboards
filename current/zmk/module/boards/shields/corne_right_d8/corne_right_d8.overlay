/*
 * Arreglo de hardware de la mitad derecha: el pin D21 (P0.31) del controlador está en
 * corto a masa, así que se le ha cortado el pin y la columna exterior (BSPC, guion,
 * slash) va con un cable en la PCB hasta D8 (P1.04). Va detrás de corne_right en
 * SHIELD para sobrescribir su col-gpios.
 */

&kscan0 {
    col-gpios
        = <&pro_micro 14 GPIO_ACTIVE_HIGH>
        , <&pro_micro 15 GPIO_ACTIVE_HIGH>
        , <&pro_micro 18 GPIO_ACTIVE_HIGH>
        , <&pro_micro 19 GPIO_ACTIVE_HIGH>
        , <&pro_micro 20 GPIO_ACTIVE_HIGH>
        , <&pro_micro 8 GPIO_ACTIVE_HIGH>
        ;
};
