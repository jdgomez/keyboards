## current/zmk/module/boards/shields/corne_right_d8/Kconfig.shield
```kconfig
config SHIELD_CORNE_RIGHT_D8
    def_bool $(shields_list_contains,corne_right_d8)
```

## current/zmk/module/boards/shields/nice_view_bongo/Kconfig.defconfig
```kconfig
# Igual que el shield nice_view de ZMK v0.3.0, solo para la mitad central.

if SHIELD_NICE_VIEW_BONGO

config LV_Z_VDB_SIZE
    default 100

config LV_DPI_DEF
    default 161

config LV_Z_BITS_PER_PIXEL
    default 1

choice LV_COLOR_DEPTH
    default LV_COLOR_DEPTH_1
endchoice

choice ZMK_DISPLAY_WORK_QUEUE
    default ZMK_DISPLAY_WORK_QUEUE_DEDICATED
endchoice

choice ZMK_DISPLAY_STATUS_SCREEN
    default ZMK_DISPLAY_STATUS_SCREEN_CUSTOM
endchoice

config LV_Z_MEM_POOL_SIZE
    default 8192

config ZMK_DISPLAY_STATUS_SCREEN_CUSTOM
    select NICE_VIEW_BONGO_WIDGET

config NICE_VIEW_BONGO_WIDGET
    bool "Bongo Cat status widget for nice!view"
    select LV_FONT_UNSCII_8
    select LV_FONT_MONTSERRAT_14
    select LV_FONT_MONTSERRAT_16
    select LV_USE_IMG
    select LV_USE_CANVAS
    select ZMK_WPM

endif # SHIELD_NICE_VIEW_BONGO
```

## current/zmk/module/boards/shields/nice_view_magikarp/Kconfig.shield
```kconfig
config SHIELD_NICE_VIEW_MAGIKARP
    def_bool $(shields_list_contains,nice_view_magikarp)
```
